## user_src/Kconfig
```kconfig
#
# For a description of the syntax of this configuration file,
# see the file kconfig-language.txt in the NuttX tools repository.
#

config STELLA_APP
	tristate "Stella App"
	default n
	select HAVE_CXX 
	select HAVE_CXXINITIALIZE
	---help---
		Enable the StellaCANRead application
```
